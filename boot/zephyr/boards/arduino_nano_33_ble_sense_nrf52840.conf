## boot/zephyr/boards/arduino_nano_33_ble_sense_nrf52840.conf
```kconfig
################################################################################
# My bootloader settings

#CONFIG_BOOT_UPGRADE_ONLY=y

#CONFIG_BOOT_VALIDATE_SLOT0=n
#CONFIG_BOOT_UPGRADE_ONLY=y
#CONFIG_SINGLE_APPLICATION_SLOT=y
#CONFIG_BOOT_WAIT_FOR_USB_DFU=y

################################################################################
################################################################################
################################################################################

################################################################################
# The settings below are from
#   - bootloader/mcuboot/boot/zephyr/boards/nrf52840dongle_nrf52840.conf
#   - bootloader/mcuboot/boot/zephyr/usb_cdc_acm_log_recovery.conf
#
# With these settings I tried to get the bootloader log messages on startup
# printed on the UART console, but I was not successfull.
# The application may correctly start at the first bootup, but
# after resetting the board only the bootloader shows up in the "dmesg" log
# without executing the actual application.
#
# The settings from "nrf52840dongle_nrf52840.conf" made the bootloader
# appear as a DFU device. But it was stuck and not able to execute the
# application in slot0.
#
# With these settings it is possible that the compiled .hex/.bin is too big
# and does not fit in the boot partition
# (when execution "west build ..." it will complain).
# For this case the board definition (devicetree) of the
# Arduino Nano 33 BLE Sense contains multiple partition layouts
# (just comment out the default layout and remove the comment around the desired
# layout definition). After changing the partition layout rebuilding the
# bootloader AND the application is necessary!

################################
# nrf52840dongle_nrf52840.conf #
################################

# # The UART is used for Serial Recovery, so logging requires
# # an RTT console, which is not available out of the box on this board.
# # Disable logging.
# CONFIG_LOG=y

# # The build won't fit on the partition allocated for it without size
# # optimizations.
# CONFIG_SIZE_OPTIMIZATIONS=y

# # Serial
# CONFIG_SERIAL=y
# CONFIG_UART_NRFX=y
# CONFIG_UART_INTERRUPT_DRIVEN=y
# CONFIG_UART_LINE_CTRL=y

# # MCUBoot serial
# CONFIG_GPIO=y
# CONFIG_MCUBOOT_SERIAL=y
# CONFIG_BOOT_SERIAL_CDC_ACM=y
# CONFIG_BOOT_SERIAL_DETECT_PORT="GPIO_0"
# CONFIG_BOOT_SERIAL_DETECT_PIN=5

# # Required by USB
# CONFIG_MULTITHREADING=y

# # USB
# CONFIG_USB=y
# CONFIG_USB_DEVICE_STACK=y
# CONFIG_USB_DEVICE_PRODUCT="MCUBOOT"
# CONFIG_USB_CDC_ACM=y
# CONFIG_USB_COMPOSITE_DEVICE=y
# CONFIG_USB_MASS_STORAGE=n

#################################
# usb_cdc_acm_log_recovery.conf #
#################################

# CONFIG_LOG=y

# # The build won't fit on the partition allocated for it without size
# # optimizations.
# #CONFIG_SIZE_OPTIMIZATIONS=y

# # Serial
# #CONFIG_SERIAL=y
# #CONFIG_UART_LINE_CTRL=y

# # MCUBoot serial
# #CONFIG_MCUBOOT_SERIAL=y
# #CONFIG_BOOT_SERIAL_CDC_ACM=y

# CONFIG_LOG_BACKEND_UART=y
# CONFIG_LOG_BACKEND_RTT=n

################################################################################
```
